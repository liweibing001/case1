#include "modbus.h"


u8	Modbus_Addr=1;			//从机地址
u8	Modbus_RX_BUFF[200];	//接收缓冲区2048字节
u16	Modbus_RX_CNT=0;		//接收计数器
u16	Modbus_RX_EN=0;			//接收倒计时
u8	Modbus_FrameFlag=0;		//帧结束标记
u8	Modbus_TX_BUFF[200];	//发送缓冲区
u8	Modbus_RX_LEN=0;		//接收数据长度

unsigned int GetCRC16(unsigned char *ptr,  unsigned char len)
{ 
    uint16_t index;
    uint8_t crcl = 0xFF;  //高CRC字节
    uint8_t crch = 0xFF;  //低CRC字节
    uint8_t  TabH[] = {  //CRC高位字节值表
        0x00, 0xC1, 0x81, 0x40, 0x01, 0xC0, 0x80, 0x41, 0x01, 0xC0,  
        0x80, 0x41, 0x00, 0xC1, 0x81, 0x40, 0x01, 0xC0, 0x80, 0x41,  
        0x00, 0xC1, 0x81, 0x40, 0x00, 0xC1, 0x81, 0x40, 0x01, 0xC0,  
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        0x80, 0x41, 0x00, 0xC1, 0x81, 0x40  
    } ;  
    u8 TabL[] = {  //CRC低位字节值表
        0x00, 0xC0, 0xC1, 0x01, 0xC3, 0x03, 0x02, 0xC2, 0xC6, 0x06,  
        0x07, 0xC7, 0x05, 0xC5, 0xC4, 0x04, 0xCC, 0x0C, 0x0D, 0xCD,  
        0x0F, 0xCF, 0xCE, 0x0E, 0x0A, 0xCA, 0xCB, 0x0B, 0xC9, 0x09,  
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        0x43, 0x83, 0x41, 0x81, 0x80, 0x40  
    } ;
 
    while (len--)  //计算指定长度的CRC
    {
        index = crcl ^ *ptr++;
        crcl = crch ^ TabH[index];
        crch = TabL[index];
    }
    
    return ((crcl<<8) | crch);  
};

////////////////////////////////////////////////////////////////////////////////////////////////////////////
//Modbus寄存器和单片机寄存器的映射关系

u16	Modbus_IO[100];	//输出开关量寄存器指针(这里使用的是位带操作)

//////////////////////////////////////////////////////////////////////////////
//发送n个字节数据
//buff:发送区首地址
//len：发送的字节数
void Modbus_SendData(u8 *buff,u8 len)
{
	u8 t;
	for(t=0;t<len;t++)	
	{
		while(USART_GetFlagStatus(MODUBS_UART,USART_FLAG_TC)==RESET);
		USART_SendData(MODUBS_UART,buff[t]); 
	}	 
	while(USART_GetFlagStatus(MODUBS_UART,USART_FLAG_TC)==RESET);
}

/////////////////////////////////////////////////////////////////////////////////////
//Modbus服务程序，用于处理接收到的数据(请在主函数中循环调用)
u16 startRegAddr;
u16 RegNum;
u16 calCRC;
void Modbus_Service(void)
{
	u16 recCRC;
	if(Modbus_FrameFlag==1)
	{
		calCRC = GetCRC16(Modbus_RX_BUFF,Modbus_RX_LEN-2);
		recCRC=Modbus_RX_BUFF[Modbus_RX_LEN-1]|(((u16)Modbus_RX_BUFF[Modbus_RX_LEN-2])<<8);
		if(calCRC==recCRC)//CRC校验正确
		{
			if(Modbus_RX_BUFF[0]==Modbus_Addr)//地址正确
			{
				startRegAddr=(((u16)Modbus_RX_BUFF[2])<<8)|Modbus_RX_BUFF[3];//获取寄存器起始地址
				switch(Modbus_RX_BUFF[1])//根据不同的功能码进行处理
				{
					case 03: //读多个寄存器
					{
						Modbus_03_Solve();
						break;
					}
					case 06: //写单个寄存器
					{
						Modbus_06_Solve();
						break;
					}
					case 16: //写多个寄存器
					{
						Modbus_16_Solve();
						break;
					}

				}
			}
		}
		Modbus_FrameFlag=0;//复位帧结束标志
		Modbus_RX_CNT=0;//接收计数器清零
		Modbus_RX_LEN = 0;
	}
}

////Modbus功能码03处理程序///////////////////////////////////////////////////////////////////////////////////////已验证程序OK
////读保持寄存器
void Modbus_03_Solve(void)
{
	u8 i;	

	RegNum= (((u16)Modbus_RX_BUFF[4])<<8)|Modbus_RX_BUFF[5];//获取寄存器数量
	if((startRegAddr+RegNum)<1000)//寄存器地址+数量在范围内
	{
		Modbus_TX_BUFF[0]=Modbus_RX_BUFF[0];
		Modbus_TX_BUFF[1]=Modbus_RX_BUFF[1];
		Modbus_TX_BUFF[2]=RegNum*2;
		for(i=0;i<RegNum*2;i++)
		{
			Modbus_TX_BUFF[3+i*2]=(Modbus_IO[startRegAddr+i]/256);//           /////////先发送高字节--在发送低字节
			Modbus_TX_BUFF[4+i*2]=(Modbus_IO[startRegAddr+i]%256); //
		}
		calCRC=GetCRC16(Modbus_TX_BUFF,RegNum*2+3);
		Modbus_TX_BUFF[RegNum*2+3]=(calCRC>>8)&0xFF;         //CRC高地位不对吗？  // 先高后低
		Modbus_TX_BUFF[RegNum*2+4]=(calCRC)&0xFF;
		Modbus_SendData(Modbus_TX_BUFF,RegNum*2+5);
	}
	else//寄存器地址+数量超出范围
	{
		Modbus_TX_BUFF[0]=Modbus_RX_BUFF[0];
		Modbus_TX_BUFF[1]=Modbus_RX_BUFF[1];
		Modbus_TX_BUFF[2]=0x02; //异常码
		Modbus_SendData(Modbus_TX_BUFF,3);
	}
}


////Modbus功能码06处理程序   //////////////////////////////////////////////////////////////////////////////////已验证程序OK
////写单个保持寄存器
void Modbus_06_Solve(void)
{
	Modbus_IO[startRegAddr]=Modbus_RX_BUFF[4]<<8;//高字节在前                    ////////修改为高字节在前，低字节在后
	Modbus_IO[startRegAddr]|=((u16)Modbus_RX_BUFF[5]);//低字节在后

	Modbus_TX_BUFF[0]=Modbus_RX_BUFF[0];
	Modbus_TX_BUFF[1]=Modbus_RX_BUFF[1];
	Modbus_TX_BUFF[2]=Modbus_RX_BUFF[2];
	Modbus_TX_BUFF[3]=Modbus_RX_BUFF[3];
	Modbus_TX_BUFF[4]=Modbus_RX_BUFF[4];
	Modbus_TX_BUFF[5]=Modbus_RX_BUFF[5];

	calCRC=GetCRC16(Modbus_TX_BUFF,6);
	Modbus_TX_BUFF[6]=(calCRC>>8)&0xFF;
	Modbus_TX_BUFF[7]=(calCRC)&0xFF;
	Modbus_SendData(Modbus_TX_BUFF,8);
}

////Modbus功能码16处理程序 /////////////////////////////////////////////////////////////////////////////////////////////////已验证程序OK
////写多个保持寄存器
void Modbus_16_Solve(void)
{
	u8 i;
	RegNum= (((u16)Modbus_RX_BUFF[4])<<8)|((Modbus_RX_BUFF[5]));//获取寄存器数量
	if((startRegAddr+RegNum)<1000)//寄存器地址+数量在范围内
	{
		for(i=0;i<RegNum;i++)
		{
			Modbus_IO[startRegAddr+i]=Modbus_RX_BUFF[7+i*2]<<8; //低字节在前                 /////// 低字节在前，高字节在后正常
			Modbus_IO[startRegAddr+i]|=((u16)Modbus_RX_BUFF[8+i*2]); //高字节在后
		}

		Modbus_TX_BUFF[0]=Modbus_RX_BUFF[0];
		Modbus_TX_BUFF[1]=Modbus_RX_BUFF[1];
		Modbus_TX_BUFF[2]=Modbus_RX_BUFF[2];
		Modbus_TX_BUFF[3]=Modbus_RX_BUFF[3];
		Modbus_TX_BUFF[4]=Modbus_RX_BUFF[4];
		Modbus_TX_BUFF[5]=Modbus_RX_BUFF[5];

		calCRC=GetCRC16(Modbus_TX_BUFF,6);
		Modbus_TX_BUFF[6]=(calCRC>>8)&0xFF;
		Modbus_TX_BUFF[7]=(calCRC)&0xFF;
		Modbus_SendData(Modbus_TX_BUFF,8);
	}
	else//寄存器地址+数量超出范围
	{
		Modbus_TX_BUFF[0]=Modbus_RX_BUFF[0];
		Modbus_TX_BUFF[1]=Modbus_RX_BUFF[1]|0x80;
		Modbus_TX_BUFF[2]=0x02; //异常码
		Modbus_SendData(Modbus_TX_BUFF,3);
	}
}

void Rec_Buf_clean(u8 *point,u8 len ) //清空数组
{
	int p;
	for (p=0;p<len;p++)
	{
		point[p]=0;
	}
}

//用于串口接收中断，进行组包
void Modbus_zubao(u8 Res)
{
	if(Modbus_RX_CNT<200)
	{
		Modbus_RX_BUFF[Modbus_RX_CNT++]=Res;
		Modbus_RX_EN = 0;
	}
	else
	{
		Rec_Buf_clean(Modbus_RX_BUFF,200);
		Modbus_RX_CNT = 0;
	}
}

//用于定时器，判断是否接收完成
#define Modbus_RX_EN_MAX 18
void Modbus_Is_jieshou(void)
{
	Modbus_RX_EN++;
	if((Modbus_RX_EN>Modbus_RX_EN_MAX) &&(Modbus_RX_CNT!=0))
	{
		Modbus_RX_LEN = Modbus_RX_CNT;
		Modbus_FrameFlag=1;//置位帧结束标记
		Modbus_RX_EN = 0;
	}
}
